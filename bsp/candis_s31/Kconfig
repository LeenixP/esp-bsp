## bsp/candis_s31/Kconfig
```kconfig
menu "Board Support Package (Candis-S31)"

    config BSP_ERROR_CHECK
        bool "Enable error check in BSP"
        default y
        help
            Abort on BSP initialization errors. Disable this option when the
            application needs to handle and report initialization failures.

    menu "I2C"
        config BSP_I2C_NUM
            int "Main I2C controller"
            default 0
            range 0 2
            help
                Controller used by the main bus on GPIO33 and GPIO34.

        config BSP_LP_I2C_NUM
            int "Low-power I2C controller"
            default 1
            range 0 2
            help
                Controller used by TG28_SW and RX8130CE on GPIO6 and GPIO7.

        config BSP_I2C_INTERNAL_PULLUPS
            bool "Enable internal I2C pull-ups"
            default n
            help
                External pull-ups are fitted on the board. Enable this only
                for controlled diagnostics.
    endmenu

    menu "Display"
        config BSP_LCD_PIXEL_CLOCK_MHZ
            int "CO5300 QSPI clock (MHz)"
            default 40
            range 10 40

        config BSP_LCD_DRAW_BUF_HEIGHT
            int "LVGL draw buffer height"
            default 80
            range 10 460

        config BSP_LCD_DRAW_BUF_DOUBLE
            bool "Use two LVGL draw buffers"
            default y
    endmenu

    menu "Storage"
        config BSP_SD_FORMAT_ON_MOUNT_FAIL
            bool "Format SD card when mounting fails"
            default n

        config BSP_SD_MOUNT_POINT
            string "SD card mount point"
            default "/sdcard"

        config BSP_SPIFFS_FORMAT_ON_MOUNT_FAIL
            bool "Format SPIFFS when mounting fails"
            default n

        config BSP_SPIFFS_MOUNT_POINT
            string "SPIFFS mount point"
            default "/spiffs"

        config BSP_SPIFFS_PARTITION_LABEL
            string "Partition label of SPIFFS"
            default "storage"

        config BSP_SPIFFS_MAX_FILES
            int "Max files supported for SPIFFS VFS"
            default 5
    endmenu

    menu "Audio"
        config BSP_I2S_NUM
            int "I2S controller"
            default 0
            range 0 2
    endmenu

    menu "Camera"
        config BSP_CAMERA_XCLK_USE_LEDC
            bool "Generate the camera XCLK with LEDC"
            default n
            help
                Leave this disabled. The ESP32-S31 CAM controller derives XCLK
                itself from PLL_F160M and drives it on the pin passed as
                dvp_pin.xclk_io, which esp_video does whenever xclk_io >= 0 and
                xclk_freq > 0 (esp_cam_ctlr_dvp_output_clock in
                esp_video_init.c). An extra LEDC channel on the same GPIO is
                redundant: the GPIO output matrix only keeps the signal
                attached last, so the LEDC output is disconnected anyway and
                merely occupies a LEDC timer and channel. Enable this only to
                drive XCLK from LEDC for a diagnostic experiment.

        config BSP_CAMERA_XCLK_LEDC_CH
            int "LEDC channel used for camera XCLK"
            default 2
            range 0 7
            help
                Only used when BSP_CAMERA_XCLK_USE_LEDC is enabled.
    endmenu

    menu "RGB LED"
        choice BSP_LED_RGB_BACKEND
            prompt "LED strip backend"
            default BSP_LED_RGB_BACKEND_RMT

            config BSP_LED_RGB_BACKEND_RMT
                bool "RMT"

            config BSP_LED_RGB_BACKEND_SPI
                bool "SPI"
        endchoice
    endmenu

endmenu
```

## components/tg28_sw/test_apps/main/Kconfig.projbuild
```kconfig
menu "TG28 SW test app"

    config TG28_SW_TEST_WITH_HARDWARE
        bool "Build the on-hardware TG28 tests instead of the pure logic tests"
        default n
        help
            When disabled (default) the test app builds test_tg28_sw.c, which
            exercises only the pure conversion logic and needs no PMIC. When
            enabled the app builds test_tg28_sw_hw.c, which talks to a real
            TG28 over I2C (SCL=GPIO33, SDA=GPIO34, IRQ=GPIO2, address 0x34)
            and requires a Candis-S31 board or a TG28 EVM.

endmenu
```
